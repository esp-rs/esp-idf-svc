## sdkconfig.defaults
```kconfig
CONFIG_LOG_DEFAULT_LEVEL_INFO=y
CONFIG_LOG_MAXIMUM_LEVEL_INFO=y

CONFIG_WPA_DPP_SUPPORT=y

CONFIG_ESP_MAIN_TASK_STACK_SIZE=15000
CONFIG_PTHREAD_TASK_STACK_SIZE_DEFAULT=12000
CONFIG_ESP_SYSTEM_EVENT_TASK_STACK_SIZE=8000
```
